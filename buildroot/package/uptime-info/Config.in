## buildroot/package/uptime-info/Config.in
```kconfig
config BR2_PACKAGE_UPTIME_INFO
	bool "uptime_info"
	help
	  Prints the uptime each second

	  https://github.com/StefanoD/SySo/tree/master/uptime-info
```

## jakub/module_skel/Kconfig
```kconfig
menu "module driver skeleton"

config MODULE_SKEL_DRIVER
  tristate "Compile with Jack Driver"
	help
  Compile with super duper Jack Driver 

endmenu
```

## jakub/treiber/Kconfig
```kconfig
config TREIBER
  tristate "With Treiber"
	help
  Compile with super duper Jack Driver 
```
